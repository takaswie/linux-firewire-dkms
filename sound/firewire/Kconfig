## sound/firewire/Kconfig
```kconfig
menuconfig SND_FIREWIRE
	bool "FireWire sound devices"
	depends on FIREWIRE
	default y
	help
	  Support for IEEE-1394/FireWire/iLink sound devices.

if SND_FIREWIRE && FIREWIRE

config SND_FIREWIRE_LIB
	tristate
	depends on SND_PCM

config SND_DICE
	tristate "DICE-based DACs (EXPERIMENTAL)"
	select SND_HWDEP
	select SND_PCM
	select SND_FIREWIRE_LIB
	help
	  Say Y here to include support for many DACs based on the DICE
	  chip family (DICE-II/Jr/Mini) from TC Applied Technologies.

	  At the moment, this driver supports playback only.  If you
	  want to use devices that support capturing, use FFADO instead.

	  To compile this driver as a module, choose M here: the module
	  will be called snd-dice.

config SND_FIREWIRE_SPEAKERS
	tristate "FireWire speakers"
	select SND_PCM
	select SND_FIREWIRE_LIB
	help
	  Say Y here to include support for the Griffin FireWave Surround
	  and the LaCie FireWire Speakers.

	  To compile this driver as a module, choose M here: the module
	  will be called snd-firewire-speakers.

config SND_ISIGHT
	tristate "Apple iSight microphone"
	select SND_PCM
	select SND_FIREWIRE_LIB
	help
	  Say Y here to include support for the front and rear microphones
	  of the Apple iSight web camera.

	  To compile this driver as a module, choose M here: the module
	  will be called snd-isight.

config SND_SCS1X
	tristate "Stanton Control System 1 MIDI"
	select SND_PCM
	select SND_RAWMIDI
	select SND_FIREWIRE_LIB
	help
	  Say Y here to include support for the MIDI ports of the Stanton
	  SCS.1d/SCS.1m DJ controllers.  (SCS.1m audio is still handled
	  by FFADO.)

	  To compile this driver as a module, choose M here: the module
	  will be called snd-scs1x.

config SND_FIREWORKS
        tristate "Echo Fireworks board support"
        select SND_PCM
        select SND_RAWMIDI
	select SND_HWDEP
	select SND_FIREWIRE_LIB
        help
          Say Y here to include support for FireWire devices based
          on Echo Digital Audio Fireworks board:
          * Mackie Onyx 400F/1200F
	  * Echo AudioFire8(until 2009 July)/AudioFire12
          * Echo AudioFire2/4/8(since 2009 July)/Pre8
          * Echo Fireworks 8/HDMI
          * Gibson RIP/GoldTop

          To compile this driver as a module, choose M here: the module
          will be called snd-fireworks.

config SND_BEBOB
	tristate "BridgeCo BeBoB chipset support"
        select SND_PCM
        select SND_RAWMIDI
	select SND_HWDEP
	select SND_FIREWIRE_LIB
        help
	 Say Y here to include support for FireWire devices based
	 on BridgeCo BeBoB chipset:
	  * M-Audio Firewire410/AudioPhile/Solo/Ozonic/NRV10
	  * M-Audio Firewire1814/ProjectMix IO/ProfireLightBridge
	  * PreSonus FIREBOX/FirePod
	  * Yamaha GO44/GO46
	  * TerraTec PHASE 24 FW/PHASE X24 FW/PHASE 88 Rack FW
	  * Edirol FA-66/FA-101
	  * Focusrite Saffire/Saffire LE/SaffirePro10 IO/SaffirePro26 IO
	  * Mackie OnyxFirewire
	  * Tascam  IF-FW/DM
	  * Behringer X32
	  * Apogee Rosetta200
	  * ESI Quotafire610
	  * AcousticReality eARMasterOne
	  * CME MatrixKFW
	  * Phonic HB24U
	  * BridgeCo RDAudio1/Audio5

          To compile this driver as a module, choose M here: the module
          will be called snd-fireworks.

endif # SND_FIREWIRE
```
